## examples/esp32_shell/sdkconfig.defaults
```kconfig
# Ethernet + littlessh server task headroom.
CONFIG_ESP_MAIN_TASK_STACK_SIZE=6144
CONFIG_ETH_USE_SPI_ETHERNET=y
CONFIG_ETH_SPI_ETHERNET_W5500=y
```
